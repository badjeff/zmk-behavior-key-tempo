## Kconfig
```kconfig
# Sensor data simulator
#
# Copyright (c) 2019 Nordic Semiconductor
#
# SPDX-License-Identifier: LicenseRef-Nordic-5-Clause
#

DT_COMPAT_ZMK_BEHAVIOR_KEY_TEMPO := zmk,behavior-key-tempo

config ZMK_BEHAVIOR_KEY_TEMPO
		bool
		default $(dt_compat_enabled,$(DT_COMPAT_ZMK_BEHAVIOR_KEY_TEMPO))
```

## dts/bindings/zmk,behavior-key-tempo.yaml
```yaml
# Copyright (c) 2021 The ZMK Contributors
# SPDX-License-Identifier: MIT

description: Key tempo behavior

compatible: "zmk,behavior-key-tempo"

include: zero_param.yaml

properties:
  usage-pages:
    type: array
    required: true
```
